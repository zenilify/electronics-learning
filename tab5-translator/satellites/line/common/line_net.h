// line_net.h — shared Wi-Fi + HTTP client for the Traceability Cell satellites (lane T5-I).
// Contract: mission-control claude/handoffs/2026-11-08-n4.md §3 (POST /scan, POST /line/event, GET /line/kpi).
//
// secrets.h is generated by tools/gen_secrets.py from cachy ~/.config/zenilify/{t5-wifi,papp_token}; it is
// gitignored and never printed. It defines LINE_WIFI[] {ssid, psk}, LINE_TOKEN, LINE_BASE and LINE_FALLBACK.
//
// LINE_BASE is N4's real server. While it still answers 404 on /line/kpi the satellites post to LINE_FALLBACK
// (tools/mock_line.py) and say so: lineIsMock() is true, the serial log prints MOCK, the LED/screen show it.
// The choice is re-probed every 60 s, so the day N4 ships no reflash is needed.
#pragma once
#include <Arduino.h>
#include <WiFi.h>
#include <WiFiMulti.h>
#include <HTTPClient.h>
#include "secrets.h"

#ifndef LINE_STATION
#define LINE_STATION "EOL-1"
#endif

static WiFiMulti s_wm;
static bool s_mock = true, s_up = false;
static uint32_t s_probe_ms = 0;

static String jesc(const String &s) {            // minimal JSON string escape
  String o; o.reserve(s.length() + 4);
  for (size_t i = 0; i < s.length(); i++) {
    char c = s[i];
    if (c == '"' || c == '\\') { o += '\\'; o += c; }
    else if ((uint8_t)c < 0x20) o += ' ';
    else o += c;
  }
  return o;
}

static int lineReq(const char *base, const char *method, const String &path, const String &body, String *reply) {
  if (WiFi.status() != WL_CONNECTED) return -1;
  HTTPClient h;
  h.setConnectTimeout(2500); h.setTimeout(4000);
  if (!h.begin(String(base) + path)) return -2;
  h.addHeader("Authorization", String("Bearer ") + LINE_TOKEN);
  int code;
  if (!strcmp(method, "GET")) code = h.GET();
  else { h.addHeader("Content-Type", "application/json"); code = h.POST(body); }
  if (reply) *reply = code > 0 ? h.getString() : String();
  h.end();
  return code;
}

static void lineProbe() {                        // which server has /line/kpi right now?
  s_probe_ms = millis();
  int c = lineReq(LINE_BASE, "GET", "/line/kpi?window=hour", "", nullptr);
  if (c == 200) { s_mock = false; s_up = true; }
  else {
    int m = lineReq(LINE_FALLBACK, "GET", "/line/kpi?window=hour", "", nullptr);
    s_mock = true; s_up = (m == 200);
    Serial.printf("[net] real=%d mock=%d\n", c, m);
  }
  Serial.printf("[net] target=%s up=%d\n", s_mock ? "MOCK" : "LIVE", s_up);
}

static bool lineWifi(uint32_t wait_ms = 15000) {
  if (WiFi.status() == WL_CONNECTED) return true;
  uint32_t t0 = millis();
  while (s_wm.run(3000) != WL_CONNECTED && millis() - t0 < wait_ms) delay(200);
  bool ok = WiFi.status() == WL_CONNECTED;
  Serial.printf("[net] wifi=%d ip=%s rssi=%d\n", ok, WiFi.localIP().toString().c_str(), ok ? WiFi.RSSI() : 0);
  return ok;
}

static void lineBegin() {
  WiFi.mode(WIFI_STA);
  WiFi.setSleep(false);
  for (auto &w : LINE_WIFI) s_wm.addAP(w.ssid, w.psk);
  if (lineWifi()) lineProbe();
}

static void lineLoop() {                         // call often; reconnects and re-probes
  if (WiFi.status() != WL_CONNECTED) { s_up = false; if (lineWifi(4000)) lineProbe(); return; }
  if (millis() - s_probe_ms > (s_up ? 60000u : 10000u)) lineProbe();
}

static void lineWifiScan() {                    // bench: which SSIDs does this board see? (names are not secrets)
  int n = WiFi.scanNetworks();
  Serial.printf("[net] scan: %d networks\n", n);
  for (int i = 0; i < n; i++) {
    bool known = false;
    for (auto &w : LINE_WIFI) known |= WiFi.SSID(i) == w.ssid;
    Serial.printf("[net]  %-24s ch%-2d %d dBm%s\n", WiFi.SSID(i).c_str(), WiFi.channel(i), WiFi.RSSI(i), known ? "  <- in t5-wifi" : "");
  }
  WiFi.scanDelete();
}

static bool lineIsMock() { return s_mock; }
static bool lineUp() { return s_up; }

static int linePost(const String &path, const String &body, String *reply = nullptr) {
  int c = lineReq(s_mock ? LINE_FALLBACK : LINE_BASE, "POST", path, body, reply);
  if (c != 200) { s_up = false; s_probe_ms = 0; }
  Serial.printf("[post] %s %s -> %d %s\n", s_mock ? "MOCK" : "LIVE", path.c_str(), c, body.c_str());
  return c;
}

// POST /scan  {code, station, operator?, kind, result, reason?}
static int lineScan(const String &code, const char *kind, const char *result, const String &reason,
                    const String &op, String *reply = nullptr) {
  String b = "{\"code\":\"" + jesc(code) + "\",\"station\":\"" LINE_STATION "\",\"kind\":\"" + kind +
             "\",\"result\":\"" + result + "\"";
  if (reason.length()) b += ",\"reason\":\"" + jesc(reason) + "\"";
  if (op.length()) b += ",\"operator\":\"" + jesc(op) + "\"";
  return linePost("/scan", b + "}", reply);
}

// POST /line/event  {station, type, operator?, reason?, text?}  (+ optional value/unit/count: asked of N4 11-10)
static int lineEvent(const char *type, const String &op, const String &reason, const String &text,
                     const String &extra = "", String *reply = nullptr) {
  String b = String("{\"station\":\"" LINE_STATION "\",\"type\":\"") + type + "\"";
  if (op.length()) b += ",\"operator\":\"" + jesc(op) + "\"";
  if (reason.length()) b += ",\"reason\":\"" + jesc(reason) + "\"";
  if (text.length()) b += ",\"text\":\"" + jesc(text) + "\"";
  if (extra.length()) b += "," + extra;
  return linePost("/line/event", b + "}", reply);
}

static long jnum(const String &j, const char *key) {   // first "key": <int> in a flat reply
  int i = j.indexOf(String("\"") + key + "\"");
  if (i < 0) return -1;
  i = j.indexOf(':', i);
  return i < 0 ? -1 : j.substring(i + 1).toInt();
}
static bool jtrue(const String &j, const char *key) {
  int i = j.indexOf(String("\"") + key + "\"");
  if (i < 0) return false;
  i = j.indexOf(':', i);
  String v = j.substring(i + 1, i + 7); v.trim();
  return v.startsWith("true");
}
